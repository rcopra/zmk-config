#include "hillside_d50.dtsi"

&kscan0 {
    col-gpios
        = <&pro_micro 19 GPIO_ACTIVE_HIGH> // schematic col0
        , <&pro_micro 18 GPIO_ACTIVE_HIGH> // schematic col1
        , <&pro_micro 15 GPIO_ACTIVE_HIGH> // schematic col2
        , <&pro_micro 14 GPIO_ACTIVE_HIGH> // schematic col3
        , <&pro_micro 16 GPIO_ACTIVE_HIGH> // schematic col4
        , <&pro_micro 10 GPIO_ACTIVE_HIGH> // schematic col5
        ;
};
