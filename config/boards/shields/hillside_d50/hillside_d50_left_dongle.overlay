/* Left half running as a peripheral. Uses the standard left-half col-gpios;
 * the matrix transform's col-offset stays at 0. Central role is disabled via
 * Kconfig.defconfig (no SHIELD_HILLSIDE_D50_LEFT_DONGLE → no central).
 */

#include "hillside_d50.dtsi"

&kscan0 {
    col-gpios
        = <&pro_micro 19 GPIO_ACTIVE_HIGH>
        , <&pro_micro 18 GPIO_ACTIVE_HIGH>
        , <&pro_micro 15 GPIO_ACTIVE_HIGH>
        , <&pro_micro 14 GPIO_ACTIVE_HIGH>
        , <&pro_micro 16 GPIO_ACTIVE_HIGH>
        , <&pro_micro 10 GPIO_ACTIVE_HIGH>
        ;
};
