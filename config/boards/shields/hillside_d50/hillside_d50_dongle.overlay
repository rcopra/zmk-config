/* Dongle overlay: runs on a XIAO BLE central, no key matrix of its own.
 * Pulls in the shared matrix transform and provides a mock kscan so the
 * Zephyr build is satisfied. Mirrors temper_dongle.overlay exactly.
 */

#include "hillside_d50_common.dtsi"

/ {
    chosen {
        zmk,kscan = &mock_kscan;
        zmk,matrix_transform = &default_transform;
    };

    mock_kscan: kscan_1 {
        compatible = "zmk,kscan-mock";
        columns = <0>;
        rows = <0>;
        events = <0>;
    };
};
