## config/boards/shields/hillside_d50/Kconfig.defconfig
```kconfig
if ZMK_BACKLIGHT

config PWM
    default y

config LED_PWM
    default y

endif # ZMK_BACKLIGHT

if SHIELD_HILLSIDE_D50_LEFT

config ZMK_KEYBOARD_NAME
    default "Hillside D50"

config ZMK_SPLIT_ROLE_CENTRAL
    default y

endif

if SHIELD_HILLSIDE_D50_DONGLE

config ZMK_KEYBOARD_NAME
    default "Hillside D50"

config ZMK_SPLIT_ROLE_CENTRAL
    default y

config ZMK_USB
    default y

endif

if SHIELD_HILLSIDE_D50_LEFT_DONGLE

config ZMK_KEYBOARD_NAME
    default "D50_L"

endif

if SHIELD_HILLSIDE_D50_RIGHT_DONGLE

config ZMK_KEYBOARD_NAME
    default "D50_R"

endif

if SHIELD_HILLSIDE_D50_LEFT || SHIELD_HILLSIDE_D50_RIGHT || SHIELD_HILLSIDE_D50_DONGLE || SHIELD_HILLSIDE_D50_LEFT_DONGLE || SHIELD_HILLSIDE_D50_RIGHT_DONGLE

config ZMK_SPLIT
    default y

endif
```

## config/boards/shields/hillside_d50/Kconfig.shield
```kconfig
config SHIELD_HILLSIDE_D50_LEFT
    def_bool $(shields_list_contains,hillside_d50_left)

config SHIELD_HILLSIDE_D50_RIGHT
    def_bool $(shields_list_contains,hillside_d50_right)

config SHIELD_HILLSIDE_D50_DONGLE
    def_bool $(shields_list_contains,hillside_d50_dongle)

config SHIELD_HILLSIDE_D50_LEFT_DONGLE
    def_bool $(shields_list_contains,hillside_d50_left_dongle)

config SHIELD_HILLSIDE_D50_RIGHT_DONGLE
    def_bool $(shields_list_contains,hillside_d50_right_dongle)
```

## config/boards/shields/temper/Kconfig.defconfig
```kconfig
if SHIELD_TEMPER_LEFT

config ZMK_KEYBOARD_NAME
    default "temper"

config ZMK_SPLIT_ROLE_CENTRAL
    default y

endif

if SHIELD_TEMPER_DONGLE

config ZMK_KEYBOARD_NAME
    default "temper"

config ZMK_SPLIT_ROLE_CENTRAL
    default y

config ZMK_USB
    default y

endif

if SHIELD_TEMPER_LEFT_DONGLE

config ZMK_KEYBOARD_NAME
    default "temper_L"

endif

if SHIELD_TEMPER_RIGHT_DONGLE

config ZMK_KEYBOARD_NAME
    default "temper_R"

endif

if SHIELD_TEMPER_LEFT || SHIELD_TEMPER_RIGHT || SHIELD_TEMPER_DONGLE || SHIELD_TEMPER_LEFT_DONGLE || SHIELD_TEMPER_RIGHT_DONGLE

config ZMK_SPLIT
    default y

endif
```

## config/west.yml
```yaml
manifest:
  remotes:
    - name: zmkfirmware
      url-base: https://github.com/zmkfirmware
    - name: temper
      url-base: https://github.com/raeedcho

  projects:
    - name: zmk
      remote: zmkfirmware
      revision: main
      import: app/west.yml
    - name: temper-zmk-config
      remote: temper
      revision: main

  self:
    path: config
```
