#include "hillside_d50.dtsi"

// Shift the right 6 columns over as the left half is 6 columns wide.
&default_transform {
    col-offset = <6>;
};

&kscan0 {
    col-gpios
        = <&pro_micro 10 GPIO_ACTIVE_HIGH> // schematic col5
        , <&pro_micro 16 GPIO_ACTIVE_HIGH> // schematic col4
        , <&pro_micro 14 GPIO_ACTIVE_HIGH> // schematic col3
        , <&pro_micro 15 GPIO_ACTIVE_HIGH> // schematic col2
        , <&pro_micro 18 GPIO_ACTIVE_HIGH> // schematic col1
        , <&pro_micro 19 GPIO_ACTIVE_HIGH> // schematic col0
        ;
};
