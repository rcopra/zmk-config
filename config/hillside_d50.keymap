/* Hillside D50 keymap.
 *
 * 50 keys = 34 base (handled by base.keymap) + 16 d50 extras (defined here).
 * LT/RT/LM/RM/LB/RB/LH/RH expand to base.keymap's per-layer alphas and thumbs;
 * the inline templates below highlight only the d50-specific positions.
 *
 * Thumb cluster L-shape (left shown; right mirrors):
 *
 *               ╭─────┬─────╮
 *               │ in  │ out │            ← upper (2 keys, sits above mid+out)
 *         ╭─────┼─────┼─────┤
 *         │ in  │ mid │ out │            ← bottom (3 keys, sticks toward inner)
 *         ╰─────┴─────┴─────╯
 */

#define CONFIG_WIRELESS

#define ZMK_BASE_LAYER(name, LT, RT, LM, RM, LB, RB, LH, RH)                                              \
    ZMK_LAYER(name,                                                                                       \
        /* ╭───────╮                                                                  ╭───────╮ */        \
           &kp TILDE        LT                                          RT            &kp BSPC            \
        /* ├───────┤                                                                  ├───────┤ */        \
           &kp GRAVE        LM                                          RM            &kp RET             \
        /* ├───────┤                                                                  ├───────┤ */        \
           &kp UNDER        LB                                          RB            &kp MINUS           \
        /* ╰───────╯                                                                  ╰───────╯ */        \
                                                                                                          \
        /*  L raised pair         L thumb upper           R thumb upper         R raised pair */          \
        /*  ╭─────┬─────╮         ╭─────┬─────╮           ╭─────┬─────╮         ╭─────┬─────╮ */          \
        /*  Raised pairs: Hyper-3 (Ctrl+Opt+Cmd) mirrored on both hands — WM modifier, = Caps Lock on laptop */ \
            &kp LC(LA(LGUI)) &none  &kp F24 TMUX_PRE      &kp KP_DIVIDE TMUX_PRE        &none &kp LC(LA(LGUI)) \
        /*  ╰─────┴─────╯         ╰─────┴─────╯           ╰─────┴─────╯         ╰─────┴─────╯ */          \
                                                                                                          \
        /*        L thumb bottom (out,mid,in)                   R thumb bottom (in,mid,out) */            \
        /*        ╭─────────┬─────────┬─────────╮            ╭─────────┬─────────┬─────────╮ */           \
                 &lt_spc NAV 0  &lt FN RET  &none                 &kp    SPACE       RH                   \
        /*        ╰─────────┴─────────┴─────────╯            ╰─────────┴─────────┴─────────╯ */           \
    )

#include "key-labels/hillside_d50.h"
#include "base.keymap"
